## main/KConfig
```kconfig
menu "ltag"

config LTAG_TX_ENABLE
    bool "Enable IR TX code"
    default y
    help
        Enables worker that monitors trigger and does shot TX

config LTAG_RX_ENABLE
    bool "Enable IR RX code"
    default y
    help
        Enables worker that monitors IR RX

endmenu
```

## main/Kconfig
```kconfig
menu "ltag"

config LTAG_TX_ENABLE
    bool "Enable IR TX code"
    default y
    help
        Enables worker that monitors trigger and does shot TX

config LTAG_TX_PIN
	int "GPIO Pin for laser TX"
	default 22
	depends on LTAG_TX_ENABLE
	help
		The GPIO pin number for the LED Transmitter

config LTAG_RX_ENABLE
    bool "Enable IR RX code"
    default y
    help
        Enables worker that monitors IR RX

config LTAG_RX_PIN
	int "GPIO Pin for IR receiver"
	default 19
	depends on LTAG_RX_ENABLE
	help
		The GPIO pin number for the LED Receiver

config LTAG_TRIGGER_PIN
	int "GPIO Pin for trigger"
	default 21
	help
		The GPIO pin number for the firing trigger


endmenu
```
